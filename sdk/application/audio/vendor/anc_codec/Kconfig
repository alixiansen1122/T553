## sdk/application/audio/vendor/anc_codec/Kconfig
```kconfig
menu "ANC CODEC Driver"

config SAP_VENDOR_DRIVER_ANC_CODEC_SUPPORT
    bool "ANC CODEC support"
    default n

if SAP_VENDOR_DRIVER_ANC_CODEC_SUPPORT

config SAP_CONTROL_ANC_CODEC_IN_ACORE
    bool "control anc codec via A core"
    default y

config SAP_CONTROL_ANC_CODEC_IN_DSP
    bool "control anc codec via DSP"
    default n

config SAP_ANC_CODEC_I2C_BUS_ID
    int "anc codec i2c bus id"
    default 0

config SAP_ANC_CODEC_I2C_ADDR
    hex "anc codec i2c address"
    default 0x28

endif

endmenu
```

## sdk/application/audio/vendor/es8156/Kconfig
```kconfig
menu "es8156 Driver"

config SAP_VENDOR_DRIVER_ES8156_SUPPORT
    bool "es8156 support"
    default n

if SAP_VENDOR_DRIVER_ES8156_SUPPORT

config SAP_CONTROL_ES8156_IN_ACORE
    bool "control es8156 via A core"
    default y

config SAP_CONTROL_ES8156_IN_DSP
    bool "control es8156 via DSP"
    default n

config SAP_ES8156_I2C_BUS_ID
    int "es8156 i2c bus id"
    default 0

config SAP_ES8156_I2C_ADDR
    hex "es8156 i2c address"
    default 0x28

endif

endmenu
```

## sdk/application/audio/vendor/es8311/Kconfig
```kconfig
menu "es8311 Driver"

config SAP_VENDOR_DRIVER_ES8311_SUPPORT
    bool "es8311 support"
    default n

if SAP_VENDOR_DRIVER_ES8311_SUPPORT

config SAP_CONTROL_ES8311_IN_ACORE
    bool "control es8311 via A core"
    default y

config SAP_CONTROL_ES8311_IN_DSP
    bool "control es8311 via DSP"
    default n

config SAP_ES8311_I2C_BUS_ID
    int "es8311 i2c bus id"
    default 0

config SAP_ES8311_I2C_ADDR
    hex "es8311 i2c address"
    default 0x28

endif

endmenu
```

## sdk/application/audio/vendor/es8396/Kconfig
```kconfig
menu "es8396 Driver"

config SAP_VENDOR_DRIVER_ES8396_SUPPORT
    bool "es8396 support"
    default n

if SAP_VENDOR_DRIVER_ES8396_SUPPORT

config SAP_CONTROL_ES8396_IN_ACORE
    bool "control es8396 via A core"
    default y

config SAP_CONTROL_ES8396_IN_DSP
    bool "control es8396 via DSP"
    default n

config SAP_ES8396_I2C_BUS_ID
    int "es8396 i2c bus id"
    default 0

config SAP_ES8396_I2C_ADDR
    hex "es8396 i2c address"
    default 0x28

endif

endmenu
```

## sdk/config.in
```kconfig
#===============================================================================
# @brief    Kconfig file.
# Copyright (c) @CompanyNameMagicTag 2022-2022. All rights reserved.
#===============================================================================
mainmenu "CFBB Configuration"
comment "Main menu description, show how to use this configuration system."

menu "Product"
    comment "Config the product."
    osource "product/Kconfig"
endmenu
```

## sdk/middleware/services/srv_tiot_host/tiot_driver/device/caxx/Kconfig
```kconfig
config CAXX_DEV_NUM
    int "CAXX device number."
    range 1 2
    default 1

if !BOARD_DYNAMIC_ALLOC
config CAXX_PACKET_BUFF_MAX
    int "Static buffer size."
    range 400 6000
    default 5000
endif
```

## sdk/middleware/services/srv_tiot_host/tiot_driver/device/gnss/Kconfig
```kconfig
config GNSS_DEV_NUM
    int "GNSS device number."
    range 1 2
    default 1

choice
    prompt "Wakeup Type."
    default GNSS_WAKEUP_TYPE_UART
    config GNSS_WAKEUP_TYPE_UART
        bool "UART"
        select PM_WAKEUP_BY_UART
    config GNSS_WAKEUP_TYPE_GPIO
        bool "GPIO"
endchoice

choice
    prompt "TCXO frequency select."
    default GNSS_TCXO_FREQ_26M
    config GNSS_TCXO_FREQ_26M
        bool "26M"
    config GNSS_TCXO_FREQ_38P4M
        bool "38.4M"
endchoice

config GNSS_UART_BAUDRATE
    int "UART communication baudrate."
    range 115200 2000000
    default 115200

config GNSS_UART_WITH_FLOWCTRL
    bool "UART with hardware flow control(CTS&RTS)."
    default n

if !BOARD_DYNAMIC_ALLOC
config GNSS_PACKET_BUFF_MAX
    int "Static buffer size."
    range 9300 15000
    default 10000
endif
```

## sdk/product/Kconfig
```kconfig
#===============================================================================
# @brief    Kconfig file.
# Copyright (c) @CompanyNameMagicTag 2022-2022. All rights reserved.
#===============================================================================
source "product/board/Kconfig"
source "product/ft/Kconfig"
source "product/tiot/Kconfig"
source "product/sensor/Kconfig"

config NORFLASH_SIZE
    int
    prompt "NOR Flash Density (MB)"
    default 8
    range 4 16
    help
        This option allows you to configure the NOR Flash density in megabytes.
        acceptable values are 4 MB、8 MB and 16 MB.
        The default value is 8 MB.

config LOAD_FROM_FS
    bool "Load from File System"
    default n
    depends on NORFLASH_SIZE = 8
    help
        This option enables loading data from the file system only if NORFLASH_SIZE is set to 8.

config PSRAM_DENSITY_MB
    int
    prompt "PSRAM Density (MB)"
    default 32
    range 16 32
    help
        This option allows you to configure the PSRAM density in megabytes.
        You can select either 16 MB or 32 MB.
        The default value is 32 MB.
```

## sdk/product/board/Kconfig
```kconfig
config PRODUCT_CHOOSE
    bool "Enable Product Choose"
    default n
    help
      Select this option to enable product choose.

if PRODUCT_CHOOSE

choice
    prompt "Product Evb Choose"
    default PRODUCT_EVB_DITING
    help
      Select the Product type.

config PRODUCT_EVB_GNSS
    bool "Product Evb Gnss"
    help
      Select this option for Product Evb Gnss.

config PRODUCT_EVB_VOLTE
    bool "Product Evb Volte"
    help
      Select this option for Product Evb Volte.

config PRODUCT_EVB_NFC
    bool "Product Evb Nfc"
    select GNSS_HSUART
    select LOWPOWER_GNSS_INIT
    select AUDIO_NOT_CTRL_I2C_INIT
    select TIOT_NOT_CTRL_I2C_INIT
    help
      Select this option for Product Evb Nfc.

config PRODUCT_EVB_DITING
    bool "Product Evb DiTing"
    select GNSS_HSUART
    select LOWPOWER_GNSS_INIT
    select AUDIO_NOT_CTRL_I2C_INIT
    select TIOT_NOT_CTRL_I2C_INIT
    help
      Select this option for Product Evb DiTing.

endchoice

endif # PRODUCT_CHOOSE

config GNSS_HSUART
    bool "Enable GNSS HSUART"
    default n
    help
      Select this option to enable GNSS HSUART.

config LOWPOWER_GNSS_INIT
    bool "Low Power GNSS Initialization"
    default n
    help
      This option enables low power initialization for GNSS.

config NANDFLASH_CS
    int "NANDFLASH CS Number"
    default 1
    range 1 2
    depends on PRODUCT_EVB_DITING
    help
      Select the NANDFLASH chip select number (1 or 2).

config AUDIO_NOT_CTRL_I2C_INIT
    bool "Audio Not Control I2C Init"
    default n
    help
      Select this option to disable I2C initialization for audio.

config TIOT_NOT_CTRL_I2C_INIT
    bool "TIOT Not Control I2C Init"
    default n
    help
      Select this option to disable I2C initialization for TIOT.
```

## sdk/product/ft/Kconfig
```kconfig
config FT_DITING
    bool
    prompt "Enable FT Diting Feature"
    default n
    help
        This option enables the FT Diting feature.
```

## sdk/product/sensor/Kconfig
```kconfig
config ENABLE_SENSOR
    bool "Enable sensor"
    default n
    help
      Select this option to enable gsensor.

config SENSOR_I2C_BUS_ID
    int "i2c bus id"
    default 2
    range 0 3
    depends on ENABLE_SENSOR
    help
      Select this option to choose i2c bus id.

config SENSOR_I2C_BAUDRATE
    int "i2c baudrate"
    default 400000
    depends on ENABLE_SENSOR
    help
      Select this option to choose i2c baudrate.

config SENSOR_I2C_MASTER_ADDR
    int "i2c master addr"
    default 0
    depends on ENABLE_SENSOR
    help
      Select this option to set i2c master addr.

config ENABLE_GSENSOR
    bool "Enable gsensor"
    default n
    depends on ENABLE_SENSOR
    help
      Select this option to enable gsensor.

config ENABLE_GSENSOR_LIS2DOC
    bool "Enable gsensor lis2doc"
    default n
    depends on ENABLE_GSENSOR
    help
      Select this option to enable gsensor lis2doc.

config GSENSOR_I2C_SLAVE_ADDR
    hex "i2c slave addr"
    default 0x19
    depends on ENABLE_GSENSOR_LIS2DOC
    help
      Select this option to set i2c slave addr.
```

## sdk/product/tiot/Kconfig
```kconfig
#===============================================================================
# @brief    Kconfig file.
# Copyright (c) @CompanyNameMagicTag 2022-2022. All rights reserved.
#===============================================================================
config FILE_BY_ARRAY
    bool "Use array file."
    default n
```
